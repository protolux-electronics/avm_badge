## components/atomvm_ble_hid/Kconfig
```kconfig
menu "ATOMVM_BLE_HID Configuration"

config AVM_BLE_HID_ENABLE
	bool "Enable AtomVM Bluetooth LE HID keyboard driver"
	default y
	depends on BT_NIMBLE_ENABLED && BT_NIMBLE_HID_SERVICE
	help
		Registers the "ble_hid" port driver, which makes the chip a
		Bluetooth LE keyboard. Needs the NimBLE host with its HID
		service; without them the driver is left out and opening the
		port fails.

endmenu
```
